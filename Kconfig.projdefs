## Kconfig.projdefs
```kconfig
menu "Cerradura Electrónica - Configuración"

    config WIFI_SSID
        string "SSID de la red WiFi"
        default "mi_red"

    config WIFI_PASSWORD
        string "Contraseña WiFi"
        default ""

    config TELEGRAM_TOKEN
        string "Token del Bot de Telegram"
        default ""
        help
            Obtenlo con @BotFather en Telegram

    config TELEGRAM_CHAT_ID
        string "Chat ID autorizado"
        default ""
        help
            Obtenlo con @userinfobot en Telegram

    config TB_TOKEN
        string "Token de ThingsBoard"
        default ""
        help
            Obtenlo en demo.thingsboard.io

    config FW_VERSION
        string "Versión del firmware"
        default "1.0.0"

endmenu
```

## sdkconfig.defaults
```kconfig
# Configuración base del proyecto — persiste tras idf.py fullclean
# Generado para ESP32-WROOM-32 con 4MB de flash

# Flash
CONFIG_ESPTOOLPY_FLASHSIZE_4MB=y
CONFIG_ESPTOOLPY_FLASHSIZE="4MB"

# Tabla de particiones personalizada (ver partitions.csv)
CONFIG_PARTITION_TABLE_CUSTOM=y
CONFIG_PARTITION_TABLE_CUSTOM_FILENAME="partitions.csv"
```
